## board/streamunlimited/stream195x/Kconfig
```kconfig
if TARGET_STREAM195X_NAND || TARGET_STREAM195X_EMMC

config SYS_BOARD
	default "stream195x"

config SYS_VENDOR
	default "streamunlimited"

config SYS_CONFIG_NAME
	default "stream195x"

choice
	prompt "Stream195x carrier board"

config TARGET_STREAM195X_STREAMKIT
	bool "StreamKit"

endchoice

config SUE_FACTORY_IMAGE
	bool "Enable Factory Image modifications"
	help
		Enable this to include factory-specific u-boot modifications.


source "board/streamunlimited/common/Kconfig"
source "board/streamunlimited/fsl_common/Kconfig"

endif
```
