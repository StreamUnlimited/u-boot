## arch/arm/Kconfig.formosa
```kconfig
#
# Realtek Semiconductor Corp.
#
# RLX Linux Kernel Configuration
#
# Tony Wu (tonywu@realtek.com)
# Dec. 07, 2008
#

#
# CPU
#
config CPU_ARMKM4
	bool
	default y if SOC_CPU_ARMKM4
	select CPU_V7M
	select SYS_ARCH_TIMER
	select OF_LIBFDT
	select SPL_BUILD

config CPU_ARMTM9
	bool
	default y if SOC_CPU_ARMTM9
	select CPU_V7M
	select SYS_ARCH_TIMER
	select OF_LIBFDT

config CPU_ARMA5
	bool
	default y if SOC_CPU_ARMA5
	select CPU_V7A
	select OF_LIBFDT

config CPU_ARMA7
	bool
	default y if SOC_CPU_ARMA7
	select CPU_V7A
	select SYS_ARCH_TIMER
	select OF_LIBFDT

config CPU_ARMA9
	bool
	default y if SOC_CPU_ARMA9
	select CPU_V7A
	select OF_LIBFDT

config CPU_ARMA12
	bool
	default y if SOC_CPU_ARMA12
	select CPU_V7A
	select SYS_ARCH_TIMER
	select OF_LIBFDT

config CPU_ARMA15
	bool
	default y if SOC_CPU_ARMA15
	select CPU_V7A
	select SYS_ARCH_TIMER
	select OF_LIBFDT

config CPU_ARMA17
	bool
	default y if SOC_CPU_ARMA17
	select CPU_V7A
	select SYS_ARCH_TIMER
	select OF_LIBFDT

config CPU_ARMA53
	bool
	default y if SOC_CPU_ARMA53
	select ARM64 if SOC_CPU_ARM64
	select CPU_V8 if SOC_CPU_ARM
	select SYS_ARCH_TIMER
	select OF_LIBFDT

config CPU_ARMA55
	bool
	default y if SOC_CPU_ARMA55
	select ARM64 if SOC_CPU_ARM64
	select CPU_V8 if SOC_CPU_ARM
	select SYS_ARCH_TIMER
	select OF_LIBFDT

config CPU_ARMA57
	bool
	default y if SOC_CPU_ARMA57
	select ARM64 if SOC_CPU_ARM64
	select CPU_V8 if SOC_CPU_ARM
	select SYS_ARCH_TIMER
	select OF_LIBFDT

config CPU_ARMA57_A53
	bool
	default y if SOC_CPU_ARMA57_A53
	select ARM64 if SOC_CPU_ARM64
	select CPU_V8 if SOC_CPU_ARM
	select SYS_ARCH_TIMER
	select OF_LIBFDT

config CPU_ARMA75_A55
	bool
	default y if SOC_CPU_ARMA75_A55
	select ARM64 if SOC_CPU_ARM64
	select CPU_V8 if SOC_CPU_ARM
	select SYS_ARCH_TIMER
	select OF_LIBFDT

#
# features
#
config SYS_ARCH_TIMER
	bool
```

## arch/mips/Kconfig.formosa
```kconfig
#
# Realtek Semiconductor Corp.
#
# Formosa Configuration
#
# Tony Wu (tonywu@realtek.com)
# Dec. 07, 2008
#

#
# CPU
#
config CPU_MIPS4K
	bool
	default y if SOC_CPU_MIPS4K

config CPU_MIPS24K
	bool
	default y if SOC_CPU_MIPS24K

config CPU_MIPS34K
	bool
	default y if SOC_CPU_MIPS34K
	select MIPS_MT if SOC_ENABLE_MT

config CPU_MIPS74K
	bool
	default y if SOC_CPU_MIPS74K
	select CPU_HAS_TLS

config CPU_MIPS1004K
	bool
	default y if SOC_CPU_MIPS1004K
	select MIPS_CPS if SOC_ENABLE_CPS
	select MIPS_MT if SOC_ENABLE_MT

config CPU_MIPS1074K
        bool
	default y if SOC_CPU_MIPS1074K
	select MIPS_CPS if SOC_ENABLE_CPS

config CPU_RLX4181
	bool
	default y if SOC_CPU_RLX4181

config CPU_RLX5181
	bool
	default y if SOC_CPU_RLX5181

config CPU_RLX4281
	bool
	default y if SOC_CPU_RLX4281 || SOC_CPU_RLX4381
	default y if SOC_CPU_RLX4271 || SOC_CPU_RLX4371
	select MIPS_CMP if SOC_ENABLE_CMP

config CPU_RLX5281
	bool
	default y if SOC_CPU_RLX5281 || SOC_CPU_RLX5381
	default y if SOC_CPU_RLX5271 || SOC_CPU_RLX5371
	select MIPS_CMP if SOC_ENABLE_CMP

config MIPS_CMP
	bool

config MIPS_MT
	bool

#
# CACHE
#
config CPU_HAS_L2C
	bool
	default y if SOC_ENABLE_L2C

config CPU_HAS_LINE_SHIFT
	bool
	default y
	select MIPS_L1_CACHE_SHIFT_4 if SYS_DCACHE_LINE_SIZE = 16
	select MIPS_L1_CACHE_SHIFT_5 if SYS_DCACHE_LINE_SIZE = 32
	select MIPS_L1_CACHE_SHIFT_6 if SYS_DCACHE_LINE_SIZE = 64
	select MIPS_L1_CACHE_SHIFT_7 if SYS_DCACHE_LINE_SIZE = 128
	select MIPS_L1_CACHE_SHIFT_5 if SYS_DCACHE_LINE_SIZE = 0

#
# BUS
#
config HW_HAS_PCI
	bool
	default y if SOC_ENABLE_PCI

config HW_HAS_USB
	bool
	default y if SOC_ENABLE_USB
```

## arch/riscv/Kconfig.formosa
```kconfig
# Formosa Configuration
#
# Tony Wu (tonywu@realtek.com)
# Dec. 07, 2008
#

#
# CPU
#
config CPU_RVTR9
	bool
	default y if SOC_CPU_RVTR9
	select ARCH_EARLY_INIT_R
	imply CPU
	imply CPU_RISCV
	imply RISCV_TIMER
```

## board/realtek/amebad2/Kconfig
```kconfig
#
# u-Boot
#

if TARGET_RTL8730E

config SYS_VENDOR
	default "realtek"

config SYS_BOARD
	default "amebad2"

config SYS_CONFIG_NAME
	default "amebad2"

config SYS_TEXT_BASE
	default "0x60400000"

endif
```

## board/realtek/amebasmart/Kconfig
```kconfig
#
# u-Boot
#

if TARGET_RTL8730E

config SYS_VENDOR
	default "realtek"

config SYS_BOARD
	default "amebasmart"

config SYS_CONFIG_NAME
	default "amebasmart"

config SYS_TEXT_BASE
	default "0x60400000"

endif
```

## board/streamunlimited/stream210/Kconfig
```kconfig
# SPDX-License-Identifier: GPL-2.0-or-later

if TARGET_STREAM210

config SYS_VENDOR
	default "streamunlimited"

config SYS_BOARD
	default "stream210"

config SYS_CONFIG_NAME
	default "stream210"

config SUE_SECURE_BOOT
	bool "StreamUnlimited secure boot additions"
	default y

endif
```

## configs/rtl8730eah-va6_defconfig
```kconfig
CONFIG_ARM=y
CONFIG_CC_OPTIMIZE_FOR_SIZE=y
CONFIG_CMD_BOOTM=y
CONFIG_CMD_CRC32=y
CONFIG_CMD_EXPORTENV=y
CONFIG_CMD_GO=y
CONFIG_CMD_IMPORTENV=y
CONFIG_CMD_NET=y
CONFIG_CMD_TESTBENCH=y
CONFIG_CMD_TIME=y
CONFIG_CPU_ARMA7=y
CONFIG_CPU_V7=y
CONFIG_EXPERT=y
CONFIG_HAS_VBAR=y
CONFIG_HAVE_GENERIC_BOARD=y
CONFIG_HAVE_PRIVATE_LIBGCC=y
CONFIG_LOCALVERSION=""
CONFIG_SOC_CPU_ARM=y
CONFIG_SOC_CPU_ARMA7=y
CONFIG_SOC_CPU_ARMv7=y
CONFIG_SOC_CPU_EL=y
CONFIG_SOC_ENABLE_IOCU=y
CONFIG_SOC_ENABLE_L2C=y
CONFIG_SOC_ENABLE_NEON=y
CONFIG_SOC_ENABLE_SMP=y
CONFIG_SOC_ENABLE_VFP=y
CONFIG_SOC_PLATFORM="ameba"
CONFIG_SUPPORT_OF_CONTROL=y
CONFIG_SYS_ARCH="arm"
CONFIG_SYS_BOARD="rtl8730e"
CONFIG_SYS_CONFIG_NAME="rtl8730e"
CONFIG_SYS_CPU="armv7"
CONFIG_SYS_EXTRA_OPTIONS=""
CONFIG_SYS_GENERIC_BOARD=y
CONFIG_SYS_HZ=1000
CONFIG_SYS_MALLOC_CLEAR_ON_INIT=y
CONFIG_SYS_VENDOR="realtek"
CONFIG_TARGET_RTL8730E=y
CONFIG_USB_ARCH_HAS_HCD=y
CONFIG_USE_PRIVATE_LIBGCC=y
CONFIG_BAUDRATE=57600
CONFIG_DM=y
CONFIG_DM_SERIAL=y
CONFIG_SERIAL_RTK_AMEBA=y
CONFIG_SYS_MALLOC_F=y
CONFIG_BOARD_EARLY_INIT_R=y
CONFIG_OF_CONTROL=y
CONFIG_OF_SEPARATE=y
CONFIG_DEFAULT_DEVICE_TREE="rtl8730e-uboot-nor"
CONFIG_SPI=y
CONFIG_DM_SPI=y
CONFIG_SPIC_RTK_AMEBA_RXI312=y
CONFIG_SPI_FLASH=y
CONFIG_DM_SPI_FLASH=y
CONFIG_SPI_RTK_AMEBA_FLASH=y
CONFIG_SPI_RTK_AMEBA_FLASH_MODE_QUAD=y
CONFIG_SPI_FLASH_SFDP_SUPPORT=y
CONFIG_CMD_SF=y
CONFIG_IMG_FLASH_ADDR=0x940000
CONFIG_IMG_FLASH_SIZE=0x500000
CONFIG_FDT_FLASH_ADDR=0x938000
CONFIG_FDT_FLASH_SIZE=0x8000
CONFIG_RECOVERY_IMG_FLASH_ADDR=0x63E000
CONFIG_RECOVERY_IMG_FLASH_SIZE=0x2FA000
CONFIG_RECOVERY_FDT_FLASH_ADDR=0x638000
CONFIG_RECOVERY_FDT_FLASH_SIZE=0x6000
CONFIG_BOOT_OPTION_MISC_FLASH_ADDR=0x620000
CONFIG_BOOT_OPTION_MISC_FLASH_SIZE=0x18000
CONFIG_SYS_TEXT_BASE=0x60300000
CONFIG_KERNEL_ADDR=0x60380000
CONFIG_FDT_ADDR=0x60370000
CONFIG_SPI_FLASH_WINBOND=y
CONFIG_SPI_FLASH_MACRONIX=y
CONFIG_SPI_FLASH_GIGADEVICE=y
CONFIG_PHY=y
CONFIG_USB_RTK_AMEBA_USB20PHY=y
CONFIG_USB_STORAGE=y
CONFIG_USB=y
CONFIG_USB_DWC2=y
CONFIG_USB_DWC2_BUFFER_SIZE=64
CONFIG_USB_HOST=y
CONFIG_DM_USB=y
CONFIG_BOOTDELAY=3
CONFIG_FS_FAT=y
CONFIG_FS_FAT_MAX_CLUSTSIZE=65536
CONFIG_CMDLINE=y
CONFIG_CMD_USB=y
CONFIG_CMD_FAT=y
```

## configs/rtl8730elh-va8_defconfig
```kconfig
CONFIG_ARM=y
CONFIG_CC_OPTIMIZE_FOR_SIZE=y
CONFIG_CMD_BOOTM=y
CONFIG_CMD_CRC32=y
CONFIG_CMD_EXPORTENV=y
CONFIG_CMD_GO=y
CONFIG_CMD_IMPORTENV=y
CONFIG_CMD_NET=y
CONFIG_CMD_TESTBENCH=y
CONFIG_CMD_TIME=y
CONFIG_CPU_V8=y
CONFIG_EXPERT=y
CONFIG_HAS_VBAR=y
CONFIG_HAVE_GENERIC_BOARD=y
CONFIG_HAVE_PRIVATE_LIBGCC=y
CONFIG_LOCALVERSION=""
CONFIG_SOC_CPU_ARM=y
CONFIG_SOC_CPU_ARMA7=y
CONFIG_SOC_CPU_ARMv7=y
CONFIG_SOC_CPU_EL=y
CONFIG_SOC_ENABLE_IOCU=y
CONFIG_SOC_ENABLE_L2C=y
CONFIG_SOC_ENABLE_NEON=y
CONFIG_SOC_ENABLE_SMP=y
CONFIG_SOC_ENABLE_VFP=y
CONFIG_SOC_PLATFORM="ameba"
CONFIG_SUPPORT_OF_CONTROL=y
CONFIG_SYS_ARCH="arm"
CONFIG_SYS_BOARD="rtl8730e"
CONFIG_SYS_CONFIG_NAME="rtl8730e"
CONFIG_SYS_CPU="armv7"
CONFIG_SYS_EXTRA_OPTIONS=""
CONFIG_SYS_GENERIC_BOARD=y
CONFIG_SYS_HZ=1000
CONFIG_SYS_MALLOC_CLEAR_ON_INIT=y
CONFIG_SYS_VENDOR="realtek"
CONFIG_TARGET_RTL8730E=y
CONFIG_USB_ARCH_HAS_HCD=y
CONFIG_USE_PRIVATE_LIBGCC=y
CONFIG_BAUDRATE=57600
CONFIG_DM=y
CONFIG_DM_SERIAL=y
CONFIG_SERIAL_RTK_AMEBA=y
CONFIG_SYS_MALLOC_F=y
CONFIG_BOARD_EARLY_INIT_R=y
CONFIG_OF_CONTROL=y
CONFIG_OF_SEPARATE=y
CONFIG_DEFAULT_DEVICE_TREE="rtl8730e-uboot-nand"
CONFIG_SPI=y
CONFIG_DM_SPI=y
CONFIG_SPIC_RTK_AMEBA_RXI312=y
CONFIG_SPIC_RTK_AMEBA_NAND=y
CONFIG_MTD=y
CONFIG_MTD_PARTITIONS=y
CONFIG_DM_MTD=y
CONFIG_MTD_NAND_CORE=y
CONFIG_MTD_SPI_NAND=y
CONFIG_CMD_MTD=y
CONFIG_CMD_MTDPARTS=y
CONFIG_IMG_FLASH_SIZE=0x400000
CONFIG_FDT_FLASH_SIZE=0x10000
CONFIG_RECOVERY_IMG_FLASH_SIZE=0x500000
CONFIG_RECOVERY_FDT_FLASH_SIZE=0x10000
CONFIG_SYS_TEXT_BASE=0x60300000
CONFIG_KERNEL_ADDR=0x60380000
CONFIG_FDT_ADDR=0x60370000
CONFIG_MTDIDS_DEFAULT="flash0=spi-nand0"
CONFIG_MTDPARTS_DEFAULT="mtdparts=spi-nand0:0x20000@0x20000(cert-bin),0x40000@0x620000(misc),0x40000@0x6A0000(vbmeta),0x40000@0x6E0000(r-vbmeta),0x60000@0x780000(r-dtb),0xF00000@0x16E0000(r-uImage),0x60000@0x720000(dtb),0xF00000@0x7E0000(uImage)"
CONFIG_PHY=y
CONFIG_USB_RTK_AMEBA_USB20PHY=y
CONFIG_USB_STORAGE=y
CONFIG_USB=y
CONFIG_USB_DWC2=y
CONFIG_USB_DWC2_BUFFER_SIZE=64
CONFIG_USB_HOST=y
CONFIG_DM_USB=y
CONFIG_BOOTDELAY=3
CONFIG_FS_FAT=y
CONFIG_FS_FAT_MAX_CLUSTSIZE=65536
CONFIG_CMDLINE=y
CONFIG_CMD_USB=y
CONFIG_CMD_FAT=y

#fatboot
CONFIG_FASTBOOT=y
CONFIG_CMD_FASTBOOT=y
USB_FUNCTION_FASTBOOT=y
CONFIG_USB_FUNCTION_FASTBOOT=y
CONFIG_ANDROID_BOOT_IMAGE=y
CONFIG_ANDROID_BOOT_IMAGE_CHECK=n
CONFIG_ANDROID_IMAGE_HEADER_LENGTH=0x800
CONFIG_FASTBOOT_FLASH_NAND=y

CONFIG_FASTBOOT_BUF_ADDR=0x60380000
CONFIG_FASTBOOT_BUF_SIZE=0xF00000

CONFIG_DM_USB_GADGET=y
CONFIG_USB_GADGET=y
CONFIG_USB_GADGET_VENDOR_NUM=0x18D1
CONFIG_USB_GADGET_PRODUCT_NUM=0x4E21
CONFIG_USB_GADGET_MANUFACTURER="realtek"

CONFIG_USB_GADGET_DWC2_OTG=y
CONFIG_USB_GADGET_VBUS_DRAW=200
CONFIG_USB_GADGET_DOWNLOAD=y

CONFIG_VERIFIED_BOOT=y
CONFIG_OTP_RTK_AMEBA=y
```

## configs/stream195x_nand_kit_defconfig
```kconfig
CONFIG_ARM=y
CONFIG_ARCH_IMX8M=y
CONFIG_SYS_TEXT_BASE=0x42200000
CONFIG_SYS_MALLOC_F_LEN=0x2000
CONFIG_SECURE_BOOT=y
CONFIG_TARGET_STREAM195X=y
CONFIG_TARGET_STREAM195X_STREAMKIT=y
CONFIG_SPL_NAND_SUPPORT=y
# CONFIG_CMD_DEKBLOB is not set
CONFIG_DEFAULT_DEVICE_TREE="fsl-imx8mm-sue-s195x-nand-kit"
# CONFIG_ANDROID_BOOT_IMAGE is not set
CONFIG_FIT=y
CONFIG_FIT_SIGNATURE=y
CONFIG_SPL_LOAD_FIT=y
CONFIG_OF_BOARD_SETUP=y
CONFIG_SYS_EXTRA_OPTIONS="IMX_CONFIG=arch/arm/mach-imx/spl_nand.cfg,SPL_TEXT_BASE=0x7E1000"
CONFIG_NAND_BOOT=y
CONFIG_CONSOLE_MUX=y
CONFIG_ARCH_MISC_INIT=y
CONFIG_BOARD_EARLY_INIT_F=y
CONFIG_SPL=y
CONFIG_SPL_BOARD_INIT=y
# CONFIG_SPL_LEGACY_IMAGE_SUPPORT is not set
CONFIG_SPL_DMA_SUPPORT=y
CONFIG_SPL_USB_HOST_SUPPORT=y
CONFIG_SPL_USB_GADGET_SUPPORT=y
CONFIG_SPL_USB_SDP_SUPPORT=y
CONFIG_HUSH_PARSER=y
CONFIG_FASTBOOT=y
CONFIG_FSL_FASTBOOT=y
CONFIG_FASTBOOT_SUE_FACTORY_SUBSET=y
CONFIG_FASTBOOT_STORAGE_NAND=y
CONFIG_FASTBOOT_BUF_ADDR=0x45000000
CONFIG_FASTBOOT_BUF_SIZE=0x4000000
# CONFIG_CMD_BOOTEFI is not set
# CONFIG_CMD_ELF is not set
# CONFIG_CMD_EXPORTENV is not set
# CONFIG_CMD_IMPORTENV is not set
# CONFIG_CMD_CRC32 is not set
CONFIG_CMD_MEMTEST=y
# CONFIG_CMD_LZMADEC is not set
# CONFIG_CMD_UNZIP is not set
# CONFIG_CMD_FLASH is not set
CONFIG_CMD_FUSE=y
CONFIG_CMD_GPIO=y
CONFIG_CMD_I2C=y
# CONFIG_CMD_LOADB is not set
# CONFIG_CMD_LOADS is not set
CONFIG_CMD_NAND_LOCK_UNLOCK=y
CONFIG_CMD_NAND_TORTURE=y
CONFIG_CMD_READ=y
CONFIG_CMD_DHCP=y
# CONFIG_CMD_NFS is not set
CONFIG_CMD_MII=y
CONFIG_CMD_PING=y
CONFIG_CMD_CACHE=y
CONFIG_CMD_PMIC=y
# CONFIG_CMD_HASH is not set
CONFIG_CMD_FAT=y
CONFIG_CMD_MTDPARTS=y
CONFIG_MTDIDS_DEFAULT="nand0=gpmi-nand"
CONFIG_MTDPARTS_DEFAULT="mtdparts=gpmi-nand:4M(spl),2M(uboot),2M(uboot2),512k(u-boot-env),512k(constants),32M(swufit),12M(fit),-(data)"
# CONFIG_SPL_DOS_PARTITION is not set
CONFIG_EFI_PARTITION=y
# CONFIG_SPL_EFI_PARTITION is not set
CONFIG_OF_CONTROL=y
CONFIG_OF_LIST=""
CONFIG_ENV_IS_IN_NAND=y
CONFIG_NET_RANDOM_ETHADDR=y
CONFIG_BLK=y
CONFIG_BOOTCOUNT_LIMIT=y
CONFIG_BOOTCOUNT_FWUPDATE=y
CONFIG_DM_GPIO=y
CONFIG_MXC_GPIO=y
CONFIG_DM_I2C=y
CONFIG_SYS_I2C_MXC=y
CONFIG_MXC_OCOTP=y
# CONFIG_MMC is not set
CONFIG_MTD=y
CONFIG_NAND=y
CONFIG_NAND_MXS=y
CONFIG_MTD_UBI=y
CONFIG_PHYLIB=y
CONFIG_PHY_SMSC=y
CONFIG_DM_ETH=y
CONFIG_PHY_GIGE=y
CONFIG_PINCTRL=y
CONFIG_PINCTRL_IMX8M=y
CONFIG_DM_PMIC=y
# CONFIG_PMIC_CHILDREN is not set
# CONFIG_SPL_PMIC_CHILDREN is not set
CONFIG_DM_PMIC_AXP15060=y
CONFIG_DM_REGULATOR=y
CONFIG_MXC_UART=y
CONFIG_DM_THERMAL=y
CONFIG_NXP_TMU=y
CONFIG_USB=y
CONFIG_DM_USB=y
CONFIG_USB_EHCI_HCD=y
CONFIG_USB_GADGET=y
CONFIG_USB_GADGET_MANUFACTURER="FSL"
CONFIG_USB_GADGET_VENDOR_NUM=0x0525
CONFIG_USB_GADGET_PRODUCT_NUM=0xa4a5
CONFIG_SDP_LOADADDR=0x42400000
CONFIG_USB_HOST_ETHER=y
CONFIG_USB_ETHER_ASIX=y
CONFIG_FS_EXT4=y
CONFIG_EXT4_WRITE=y
CONFIG_LZMA=y
CONFIG_LZO=y
```

## configs/stream210_defconfig
```kconfig
CONFIG_TARGET_STREAM210=y
CONFIG_SYS_TEXT_BASE=0x60800000
CONFIG_ENV_SIZE=0x40000
CONFIG_ENV_OFFSET=0x0
# CONFIG_ANDROID_BOOT_IMAGE is not set
CONFIG_FIT=y
CONFIG_FIT_SIGNATURE=y
CONFIG_FIT_ADDR=0x64000000
CONFIG_IMG_FLASH_SIZE=0x500000
CONFIG_FDT_FLASH_SIZE=0x10000
CONFIG_RECOVERY_IMG_FLASH_SIZE=0x380000
CONFIG_RECOVERY_FDT_FLASH_SIZE=0x10000
CONFIG_BOOTDELAY=2
CONFIG_BOARD_LATE_INIT=y
CONFIG_BOARD_EARLY_INIT_R=y
CONFIG_CMD_TESTBENCH=y
CONFIG_HUSH_PARSER=y
CONFIG_CMD_BOOTZ=y
# CONFIG_BOOTM_NETBSD is not set
# CONFIG_BOOTM_PLAN9 is not set
# CONFIG_BOOTM_RTEMS is not set
# CONFIG_BOOTM_VXWORKS is not set
# CONFIG_CMD_BOOTEFI is not set
# CONFIG_CMD_ELF is not set
# CONFIG_CMD_XIMG is not set
# CONFIG_CMD_FLASH is not set
CONFIG_CMD_MTD=y
CONFIG_CMD_USB=y
CONFIG_CMD_DHCP=y
# CONFIG_BOOTP_BOOTPATH is not set
# CONFIG_BOOTP_DNS is not set
# CONFIG_BOOTP_HOSTNAME is not set
CONFIG_CMD_TIME=y
CONFIG_CMD_FAT=y
CONFIG_OF_CONTROL=y
CONFIG_DEFAULT_DEVICE_TREE="stream210"
CONFIG_ENV_IS_IN_MTD=y
CONFIG_ENV_SIZE_REDUND=0x80000
CONFIG_ENV_MTD_NAME="environment"
CONFIG_DM=y
CONFIG_BOOTCOUNT_LIMIT=y
CONFIG_BOOTCOUNT_FWUPDATE=y
CONFIG_BOOTCOUNT_BOOTLIMIT=9
CONFIG_USB_FUNCTION_FASTBOOT=y
CONFIG_FASTBOOT_BUF_ADDR=0x68000000
CONFIG_FASTBOOT_BUF_SIZE=0x4000000
CONFIG_FASTBOOT_UUU_SUPPORT=y
# CONFIG_MMC is not set
CONFIG_MTD=y
CONFIG_DM_MTD=y
CONFIG_MTD_SPI_NAND=y
CONFIG_PHY=y
CONFIG_BAUDRATE=115200
CONFIG_DM_SERIAL=y
CONFIG_SPI=y
CONFIG_DM_SPI=y
CONFIG_USB=y
CONFIG_DM_USB=y
CONFIG_DM_USB_GADGET=y
CONFIG_USB_DWC2=y
CONFIG_USB_STORAGE=y
CONFIG_USB_GADGET=y
CONFIG_USB_GADGET_MANUFACTURER="StreamUnlimited"
CONFIG_USB_GADGET_VENDOR_NUM=0x18d1
CONFIG_USB_GADGET_PRODUCT_NUM=0x4e21
CONFIG_USB_GADGET_DWC2_OTG=y
CONFIG_USB_GADGET_VBUS_DRAW=200
CONFIG_USB_HOST_ETHER=y
CONFIG_USB_ETHER_ASIX=y
CONFIG_USB_ETHER_ASIX88179=y
CONFIG_USB_RTK_AMEBA_USB20PHY=y
CONFIG_SPIC_RTK_AMEBA_RXI312=y
CONFIG_SPIC_RTK_AMEBA_NAND=y
CONFIG_SERIAL_RTK_AMEBA=y
# CONFIG_GENERATE_SMBIOS_TABLE is not set
```

## drivers/rtkdrivers/Kconfig
```kconfig
# SPDX-License-Identifier: GPL-2.0
menu "Drivers for Realtek"

source "drivers/rtkdrivers/phy/Kconfig"

source "drivers/rtkdrivers/spi/Kconfig"

source "drivers/rtkdrivers/serial/Kconfig"

source "drivers/rtkdrivers/otp/Kconfig"

endmenu
```

## drivers/rtkdrivers/otp/Kconfig
```kconfig
config OTP_RTK_AMEBA
	bool "OTP Driver"
	select MISC
	help
		Support the OTP for Realtek Soc
```

## drivers/rtkdrivers/phy/Kconfig
```kconfig
config USB_RTK_AMEBA_USB20PHY
	bool "USB PHY Driver"
	depends on PHY
	help
		Support the USB20PHY for Realtek SoCs
```

## drivers/rtkdrivers/serial/Kconfig
```kconfig
config SERIAL_RTK_AMEBA
        bool "UART Driver"
		depends on DM_SERIAL
        help
          Select this to enable UART on Ameba SoCs.
```

## drivers/rtkdrivers/spi/Kconfig
```kconfig
config SPIC_RTK_AMEBA_RXI312
        bool "SPIC driver"
		depends on DM_SPI
        help
          Enable the Ameba SPI driver. This driver can be used to
          access the SPI interface on Ameba platform.

config SPIC_RTK_AMEBA_NAND
        bool "Enable SPI nand flash drivers"
        depends on SPIC_RTK_AMEBA_RXI312
        help
          Enable the SPI nand driver.
```
